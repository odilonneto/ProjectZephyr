## build/Kconfig/arch/Kconfig
```kconfig
# Load Zephyr Arch Kconfig descriptions.
osource "C:/Users/odilo/zephyrproject/zephyr/arch/rx/Kconfig"
osource "C:/Users/odilo/zephyrproject/zephyr/arch/x86/Kconfig"
osource "C:/Users/odilo/zephyrproject/zephyr/arch/xtensa/Kconfig"
osource "C:/Users/odilo/zephyrproject/zephyr/arch/sparc/Kconfig"
osource "C:/Users/odilo/zephyrproject/zephyr/arch/riscv/Kconfig"
osource "C:/Users/odilo/zephyrproject/zephyr/arch/posix/Kconfig"
osource "C:/Users/odilo/zephyrproject/zephyr/arch/mips/Kconfig"
osource "C:/Users/odilo/zephyrproject/zephyr/arch/arm64/Kconfig"
osource "C:/Users/odilo/zephyrproject/zephyr/arch/arm/Kconfig"
osource "C:/Users/odilo/zephyrproject/zephyr/arch/arc/Kconfig"
```

## build/Kconfig/boards/Kconfig
```kconfig
# Load Zephyr board Kconfig descriptions.
osource "C:/Users/odilo/zephyrproject/zephyr/boards/st/stm32f429i_disc1/Kconfig"
```

## build/Kconfig/boards/Kconfig.defconfig
```kconfig
# Load Zephyr board defconfig descriptions.
osource "C:/Users/odilo/zephyrproject/zephyr/boards/st/stm32f429i_disc1/Kconfig.defconfig"
```

## build/Kconfig/boards/Kconfig.stm32f429i_disc1
```kconfig
# Load board Kconfig descriptions.
osource "C:/Users/odilo/zephyrproject/zephyr/boards/st/stm32f429i_disc1/Kconfig.stm32f429i_disc1"
```

## build/Kconfig/boards/Kconfig.sysbuild
```kconfig
# Load Sysbuild board Kconfig descriptions.
osource "C:/Users/odilo/zephyrproject/zephyr/boards/st/stm32f429i_disc1/Kconfig.sysbuild"
```
